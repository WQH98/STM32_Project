# file: 01_Shell_Template.ioc
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Mcu.Family=STM32F4
Mcu.Name=STM32F429I(E-G)Tx
Mcu.Package=LQFP176
NVIC.PriorityGroup=NVIC_PRIORITYGROUP_4
PA13.Mode=Serial_Wire
PA13.Signal=SYS_JTMS-SWDIO
PA14.Mode=Serial_Wire
PA14.Signal=SYS_JTCK-SWCLK
PH0/OSC_IN.Mode=HSE-External-Oscillator
PH0/OSC_IN.Signal=RCC_OSC_IN
PH1/OSC_OUT.Mode=HSE-External-Oscillator
PH1/OSC_OUT.Signal=RCC_OSC_OUT
ProjectManager.HeapSize=0x200
ProjectManager.StackSize=0x400
ProjectManager.TargetToolchain=STM32CubeIDE
RCC.48MHZClocksFreq_Value=90000000
RCC.AHBFreq_Value=180000000
RCC.APB1CLKDivider=RCC_HCLK_DIV4
RCC.APB1Freq_Value=45000000
RCC.APB1TimFreq_Value=90000000
RCC.APB2CLKDivider=RCC_HCLK_DIV2
RCC.APB2Freq_Value=90000000
RCC.APB2TimFreq_Value=180000000
RCC.CortexFreq_Value=180000000
RCC.HCLKFreq_Value=180000000
RCC.HSE_VALUE=25000000
RCC.HSI_VALUE=16000000
RCC.LSE_VALUE=32768
RCC.PLLM=15
RCC.PLLN=216
RCC.PLLSourceVirtual=RCC_PLLSOURCE_HSE
RCC.SYSCLKFreq_VALUE=180000000
RCC.SYSCLKSource=RCC_SYSCLKSOURCE_PLLCLK
RCC.VCOOutputFreq_Value=360000000
board=custom

// file: Core/Src/main.c
/* USER CODE BEGIN Header */
/**
  ******************************************************************************
  * @file           : main.c
  * @brief          : Main program body
  ******************************************************************************
  * @attention
  *
  * Copyright (c) 2024 STMicroelectronics.
  * All rights reserved.
  *
  * This software is licensed under terms that can be found in the LICENSE file
  * in the root directory of this software component.
  * If no LICENSE file comes with this software, it is provided AS-IS.
  *
  ******************************************************************************
  */
/* USER CODE END Header */
#include "main.h"
#include "gpio.h"
#include "stdio.h"
/* USER CODE BEGIN Includes */
#include "led.h"
#include "uart.h"
#include "adc.h"
#include "inner_temperature.h"
#include "tim.h"
#include "key.h"
#include "at24cxx.h"
#include "pcf8574t.h"
#include "w25qxx.h"
#include "dma.h"
#include "shell.h"
#include "shell_port.h"
/* USER CODE END Includes */

void SystemClock_Config(void);

/* USER CODE BEGIN 0 */
uint8_t iic_text_buff[] = {"Apollo STM32F4 IIC TEST"};
uint8_t spi_text_buff[] = {"Apollo STM32F4 SPI TEST"};
#define IIC_SIZE sizeof(iic_text_buff)
#define SPI_SIZE sizeof(spi_text_buff)
uint8_t iic_datatemp[IIC_SIZE];
uint8_t spi_datatemp[SPI_SIZE];
/* USER CODE END 0 */

int main(void) {
    /* USER CODE BEGIN 1 */
    uint8_t count = 0;
    uint8_t beep_status = 0;
    uint32_t FLASH_SIZE = 32*1024*1024;
    /* USER CODE END 1 */

    /* MCU Configuration--------------------------------------------------------*/

    /* Reset of all peripherals, Initializes the Flash interface and the Systick. */
    HAL_Init();

    /* Configure the system clock */
    SystemClock_Config();

    /* Initialize all configured peripherals */
    // HAL_Delay(2000);
    // HAL_Delay(2000);
    // HAL_Delay(2000);
    // HAL_Delay(2000);
    // HAL_Delay(2000);

    MX_GPIO_Init();
    led_init();
    uart1_init(115200);
    uart2_init(115200);
    // adc1_init();
    // tim3_init(4999, 8999);
    key_init();
    if(pcf8574_init() == 0) {
        my_printf(&uart1_handler, "pcf8574 check ok\r\n");
    }
    else {
        my_printf(&uart1_handler, "pcf8574 check failed\r\n");
    }
    // iic_init();
    // HAL_Delay(10);
    // if(at24cxx_check() == 0) {
    //     my_printf(&uart1_handler, "at24cxx check ok\r\n");
    // }
    // else {
    //     my_printf(&uart1_handler, "at24cxx check failed\r\n");
    // }
    // w25qxx_init();
    // while(w25qxx_read_id() != W25Q256) {
    //     my_printf(&uart1_handler, "w25q256 check failed %d\r\n", w25qxx_read_id());
    //     HAL_Delay(500);
    // }
    // my_printf(&uart1_handler, "w25q256 check ok\r\n");

    // dma2_stream0_init();
    // // 等待DMA传输完成
    // while(__HAL_DMA_GET_FLAG(&dma2_stream0_handle, DMA_FLAG_TCIF0_4) == DISABLE){}
    // // 比较源数据和传输后的数据
    // if(buffer_cmp(aSRC_Const_Buffer, aDST_Buffer, BUFFER_SIZE) == 0) {
    //     my_printf(&uart1_handler, "DMA transfer ok\r\n");
    // }
    // else {
    //     my_printf(&uart1_handler, "DMA transfer failed\r\n");
    // }
    //
    // dma2_stream7_init();

    my_printf(&uart2_handler, "Shell start\r\n");

    userShellInit();

    // HAL_UART_Transmit_DMA(&uart1_handler, "Hello World\r\n", 13);

    /* Infinite loop */
    while (1) {

        /* USER CODE BEGIN 3 */
#if 0
        if(HAL_GPIO_ReadPin(KEY0_PORT, KEY0_PIN) == RESET) {
            HAL_Delay(49);
            if(HAL_GPIO_ReadPin(KEY0_PORT, KEY0_PIN) == RESET) {
                at24cxx_write(0, (uint8_t*)iic_text_buff, IIC_SIZE);
                w25qxx_write((uint8_t*)spi_text_buff, FLASH_SIZE-100, SPI_SIZE);
            }
            while(!HAL_GPIO_ReadPin(KEY0_PORT, KEY0_PIN));
        }

        if(HAL_GPIO_ReadPin(KEY1_PORT, KEY1_PIN) == RESET) {
            HAL_Delay(49);
            if(HAL_GPIO_ReadPin(KEY1_PORT, KEY1_PIN) == RESET) {
                at24cxx_read(0, iic_datatemp, IIC_SIZE);
                my_printf(&uart1_handler, "at24cxx read data: %s\t", iic_datatemp);
                w25qxx_read(spi_datatemp, FLASH_SIZE-100, SPI_SIZE);
                my_printf(&uart1_handler, "w25qxx read data: %s\r\n", spi_datatemp);
                memset(iic_datatemp, '0', IIC_SIZE);
                memset(spi_datatemp, '0', SPI_SIZE);
            }
            while(!HAL_GPIO_ReadPin(KEY1_PORT, KEY1_PIN));
        }

        if(HAL_GPIO_ReadPin(KEY2_PORT, KEY2_PIN) == RESET) {
            HAL_Delay(49);
            if(HAL_GPIO_ReadPin(KEY2_PORT, KEY2_PIN) == RESET) {
                beep_status = !beep_status;
                pcf8574_write_bit(BEEP_IO, beep_status);
            }
            while(!HAL_GPIO_ReadPin(KEY2_PORT, KEY2_PIN));
        }

        if(HAL_GPIO_ReadPin(IIC_INT_PORT, IIC_INT_PIN) == 0) {
            my_printf(&uart1_handler, "1 press\r\n");
            if(pcf8574_read_bit(EX_IO) == 0) {
                led1_reversal();
                my_printf(&uart1_handler, "key2 press\r\n");
            }
        }

        led0_reversal();
        HAL_UART_Transmit_DMA(&uart1_handler, "Hello World\r\n", 13);
        HAL_Delay(500);
#endif
        shellTask(&shell);
        // led0_reversal();
        // HAL_Delay(500);
    }
    /* USER CODE END 3 */
}

void SystemClock_Config(void) {
    RCC_OscInitTypeDef RCC_OscInitStruct = {0};
    RCC_ClkInitTypeDef RCC_ClkInitStruct = {0};

    /** Configure the main internal regulator output voltage
    */
    __HAL_RCC_PWR_CLK_ENABLE();
    __HAL_PWR_VOLTAGESCALING_CONFIG(PWR_REGULATOR_VOLTAGE_SCALE1);

    /** Initializes the RCC Oscillators according to the specified parameters
    * in the RCC_OscInitTypeDef structure.
    */
    RCC_OscInitStruct.OscillatorType = RCC_OSCILLATORTYPE_HSE;
    RCC_OscInitStruct.HSEState = RCC_HSE_ON;
    RCC_OscInitStruct.PLL.PLLState = RCC_PLL_ON;
    RCC_OscInitStruct.PLL.PLLSource = RCC_PLLSOURCE_HSE;
    RCC_OscInitStruct.PLL.PLLM = 15;
    RCC_OscInitStruct.PLL.PLLN = 216;
    RCC_OscInitStruct.PLL.PLLP = RCC_PLLP_DIV2;
    RCC_OscInitStruct.PLL.PLLQ = 4;
    if (HAL_RCC_OscConfig(&RCC_OscInitStruct) != HAL_OK) {
        Error_Handler();
    }

    /** Activate the Over-Drive mode
    */
    if (HAL_PWREx_EnableOverDrive() != HAL_OK) {
        Error_Handler();
    }

    /** Initializes the CPU, AHB and APB buses clocks
    */
    RCC_ClkInitStruct.ClockType = RCC_CLOCKTYPE_HCLK | RCC_CLOCKTYPE_SYSCLK
                                  | RCC_CLOCKTYPE_PCLK1 | RCC_CLOCKTYPE_PCLK2;
    RCC_ClkInitStruct.SYSCLKSource = RCC_SYSCLKSOURCE_PLLCLK;
    RCC_ClkInitStruct.AHBCLKDivider = RCC_SYSCLK_DIV1;
    RCC_ClkInitStruct.APB1CLKDivider = RCC_HCLK_DIV4;
    RCC_ClkInitStruct.APB2CLKDivider = RCC_HCLK_DIV2;

    if (HAL_RCC_ClockConfig(&RCC_ClkInitStruct, FLASH_LATENCY_5) != HAL_OK) {
        Error_Handler();
    }
}

void Error_Handler(void) {
    __disable_irq();
    while (1) {
    }
}

# file: STM32F103ZET6_FreeRTOS_Templete.ioc
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Mcu.Family=STM32F1
Mcu.Name=STM32F103Z(C-D-E)Tx
Mcu.Package=LQFP144
NVIC.PriorityGroup=NVIC_PRIORITYGROUP_4
NVIC.TIM1_UP_IRQn=true\:15\:0\:false\:false\:true\:false\:true\:true
NVIC.TimeBase=TIM1_UP_IRQn
NVIC.TimeBaseIP=TIM1
OSC_IN.Mode=HSE-External-Oscillator
OSC_IN.Signal=RCC_OSC_IN
OSC_OUT.Mode=HSE-External-Oscillator
OSC_OUT.Signal=RCC_OSC_OUT
PA13.Mode=Trace_Synchro_2bits_SW
PA13.Signal=SYS_JTMS-SWDIO
PA14.Mode=Trace_Synchro_2bits_SW
PA14.Signal=SYS_JTCK-SWCLK
PE2.Mode=Trace_Synchro_2bits_SW
PE2.Signal=SYS_TRACECLK
PE3.Mode=Trace_Synchro_2bits_SW
PE3.Signal=SYS_TRACED0
PE4.Mode=Trace_Synchro_2bits_SW
PE4.Signal=SYS_TRACED1
ProjectManager.HeapSize=0x200
ProjectManager.StackSize=0x400
ProjectManager.TargetToolchain=MDK-ARM V5.32
RCC.AHBFreq_Value=72000000
RCC.APB1CLKDivider=RCC_HCLK_DIV2
RCC.APB1Freq_Value=36000000
RCC.APB1TimFreq_Value=72000000
RCC.APB2Freq_Value=72000000
RCC.APB2TimFreq_Value=72000000
RCC.HCLKFreq_Value=72000000
RCC.PLLMUL=RCC_PLL_MUL9
RCC.PLLSourceVirtual=RCC_PLLSOURCE_HSE
RCC.SYSCLKFreq_VALUE=72000000
RCC.SYSCLKSource=RCC_SYSCLKSOURCE_PLLCLK
RCC.USBFreq_Value=72000000
VP_SYS_VS_tim1.Mode=TIM1
board=custom

// file: Core/Src/main.c
/* USER CODE BEGIN Header */
/**
 ******************************************************************************
 * @file           : main.c
 * @brief          : Main program body
 ******************************************************************************
 * @attention
 *
 * Copyright (c) 2023 STMicroelectronics.
 * All rights reserved.
 *
 * This software is licensed under terms that can be found in the LICENSE file
 * in the root directory of this software component.
 * If no LICENSE file comes with this software, it is provided AS-IS.
 *
 ******************************************************************************
 */
/* USER CODE END Header */
#include "main.h"
#include "gpio.h"

/* USER CODE BEGIN Includes */
#include "FreeRTOS.h"
#include "led.h"
#include "usart.h"
#include "task.h"
#include "esp8266.h"
/* USER CODE END Includes */

/* USER CODE BEGIN PD */

void WIFI_Task(void* pvParameters)
{
	uint16_t cnt = 0;
    uint8_t *pData;
    char *data;
    int reclen = 0;
	uint8_t *message;
	uint16_t message_len;
    uint8_t message_i = 0;
	uint16_t revmessagelen = 0;
	uint8_t revmessage[50];
	uint8_t Heart[2] = {0xC0, 0x00};
	ESP8266_Clear();
	ESP8266_SendData(Bind_OneNet(), 42);
    pData = ESP8266_GetIPD(300);
    if(pData != NULL)
    {
        printf("pData[3] = %X\r\n", pData[3]);
    }
    else
    {
        printf("could not get IPD\r\n");
    }
	ESP8266_Clear();
	for(;;)
	{
		if(cnt == 10000)
		{
			message = OneNet_SendMessage("Test", "123456");
			message_len = message[1] + 2;
			ESP8266_SendData(message, message_len);
		}
        if(cnt == 20000)
		{
			message = OneNet_SendMessage("Test", "6789");
			message_len = message[1] + 2;
			ESP8266_SendData(message, message_len);
		}
		if(cnt == 30000)
		{
			ESP8266_SendData(Heart, 2);
			cnt = 0;
		}
		if(USART3_RX_STA_SIGN == 1)
		{
            reclen = USART3_RX_STA;
			if(reclen > 50)
			{
				message_i = 0;
                memset(revmessage, 0, 50);
				//HAL_UART_Transmit(&USART1_Handler, USART3_RX_BUF, USART3_RX_STA, 200);
				for(int i = 0; i < reclen; i++)
				{
					if(USART3_RX_BUF[i] == '/')
					{
						message_i = i + 1;
						break;
					}
				}
				//printf("reclen = %d\r\n", reclen);
				if(message_i == 0)
				{
					printf("not found\r\n");
				}

				revmessagelen = reclen - message_i - 36;
				//printf("revmessagelen = %d  reclen = %d  message_i = %d\r\n", revmessagelen, reclen, message_i);
				for(int i = message_i + 36, j = 0; i < reclen; i++, j++)
				{
					//printf("%c", USART3_RX_BUF[i]);
					revmessage[j] = USART3_RX_BUF[i];
				}
				//printf("\r\n");
				HAL_UART_Transmit(&USART1_Handler, revmessage, revmessagelen, 200);
				if(strcmp((const char*)revmessage, "greenledon") == 0)
				{
					GreenLED_ON();
				}
                else if(strcmp((const char*)revmessage, "greenledoff") == 0)
                {
                    GreenLED_OFF();
                }
				else if(strcmp((const char*)revmessage, "redledon") == 0)
                {
                    RedLED_ON();
                }
				else if(strcmp((const char*)revmessage, "redledoff") == 0)
                {
                    RedLED_OFF();
                }
			}
			ESP8266_Clear();
		}
		cnt++;
        vTaskDelay(pdMS_TO_TICKS(1));
	}
}

/* USER CODE END PD */

void SystemClock_Config(void);

int main(void)
{

    /* MCU Configuration--------------------------------------------------------*/

    /* Reset of all peripherals, Initializes the Flash interface and the Systick. */
    HAL_Init();

    /* Configure the system clock */
    SystemClock_Config();

    /* USER CODE BEGIN SysInit */
    LED_Init();
    USART1_Init(115200);
	USART3_Init(115200);
	HAL_Delay(500);

    /* USER CODE END SysInit */

    /* Initialize all configured peripherals */
    MX_GPIO_Init();

    ESP8266_Init();

    //HAL_UART_Transmit(&USART1_Handler, Bind_OneNet(), 42, 200);
    /* USER CODE BEGIN 2 */
    xTaskCreate(WIFI_Task, "WIFI_Task", 3000, NULL, 1, NULL);
    vTaskStartScheduler();

    /* USER CODE END 2 */

    /* Infinite loop */
    while (1)
    {
        //printf("error\r\n");
		HAL_Delay(500);
    }
}

void SystemClock_Config(void)
{
    RCC_OscInitTypeDef RCC_OscInitStruct = {0};
    RCC_ClkInitTypeDef RCC_ClkInitStruct = {0};

    /** Initializes the RCC Oscillators according to the specified parameters
     * in the RCC_OscInitTypeDef structure.
     */
    RCC_OscInitStruct.OscillatorType = RCC_OSCILLATORTYPE_HSE;
    RCC_OscInitStruct.HSEState = RCC_HSE_ON;
    RCC_OscInitStruct.HSEPredivValue = RCC_HSE_PREDIV_DIV1;
    RCC_OscInitStruct.HSIState = RCC_HSI_ON;
    RCC_OscInitStruct.PLL.PLLState = RCC_PLL_ON;
    RCC_OscInitStruct.PLL.PLLSource = RCC_PLLSOURCE_HSE;
    RCC_OscInitStruct.PLL.PLLMUL = RCC_PLL_MUL9;
    if (HAL_RCC_OscConfig(&RCC_OscInitStruct) != HAL_OK)
    {
        Error_Handler();
    }

    /** Initializes the CPU, AHB and APB buses clocks
     */
    RCC_ClkInitStruct.ClockType = RCC_CLOCKTYPE_HCLK | RCC_CLOCKTYPE_SYSCLK | RCC_CLOCKTYPE_PCLK1 | RCC_CLOCKTYPE_PCLK2;
    RCC_ClkInitStruct.SYSCLKSource = RCC_SYSCLKSOURCE_PLLCLK;
    RCC_ClkInitStruct.AHBCLKDivider = RCC_SYSCLK_DIV1;
    RCC_ClkInitStruct.APB1CLKDivider = RCC_HCLK_DIV2;
    RCC_ClkInitStruct.APB2CLKDivider = RCC_HCLK_DIV1;

    if (HAL_RCC_ClockConfig(&RCC_ClkInitStruct, FLASH_LATENCY_2) != HAL_OK)
    {
        Error_Handler();
    }
}

void HAL_TIM_PeriodElapsedCallback(TIM_HandleTypeDef *htim)
{
    if (htim->Instance == TIM1)
    {
        HAL_IncTick();
    }
}

void Error_Handler(void)
{
    __disable_irq();
    while (1)
    {
    }
}
